byte P[] = { 0x78, 0x44, 0x44, 0x78, 0x40, 0x40, 0x40, 0x40 };
byte R[] = { 0x78, 0x44, 0x44, 0x78, 0x70, 0x58, 0x4C, 0x46 };
byte O[] = { 0x3C, 0x42, 0x42, 0x42, 0x42, 0x42, 0x42, 0x3C };
byte M[] = { 0x66, 0x7E, 0x5A, 0x42, 0x42, 0x42, 0x42, 0x42 };
byte E[] = { 0x7C, 0x40, 0x40, 0x78, 0x78, 0x40, 0x40, 0x7C };
byte T[] = { 0x7E, 0x18, 0x18, 0x18, 0x18, 0x18, 0x18, 0x18 };
byte C[] = { 0x7c, 0x40, 0x40, 0x40, 0x40, 0x40, 0x40, 0x7C };
byte N[] = { 0x42, 0x62, 0x72, 0x5A, 0x4E, 0x46, 0x42, 0x42 };
byte dot[]={ 0x00, 0x00, 0x00, 0x00, 0x00, 0x00, 0x06, 0x06 };
byte sp[]= { 0x00, 0x00, 0x00, 0x00, 0x00, 0x00, 0x00, 0x00 };



  {0x00, 0x00, 0x00, 0x00, 0x00, 0x00, 0x00, 0x00}, // Char ( )
  {0x18, 0x3C, 0x3C, 0x18, 0x18, 0x00, 0x18, 0x00}, // Char (!)
  {0x66, 0x66, 0x24, 0x00, 0x00, 0x00, 0x00, 0x00}, // Char (")
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  {0x76, 0xDC, 0x00, 0x00, 0x00, 0x00, 0x00, 0x00}, // Char (~)
 void setup()                                        
 {   
    pinMode(2, OUTPUT);
    pinMode(3, OUTPUT);
    pinMode(4, OUTPUT);
    pinMode(5, OUTPUT);
    pinMode(6, OUTPUT);
    pinMode(7, OUTPUT);
    pinMode(8, OUTPUT);
    pinMode(9, OUTPUT);
    pinMode(10, OUTPUT);
    pinMode(11, OUTPUT);
    pinMode(12, OUTPUT);
    pinMode(13, OUTPUT);
    pinMode(30, OUTPUT);
    pinMode(31, OUTPUT);
    pinMode(32, OUTPUT);
    pinMode(33, OUTPUT);     
    Serial.begin(9600);
 }


bool GetBit( byte N, int pos)
   {                 // pos = 7 6 5 4 3 2 1 0
       int b = N >> pos ;         // Shift bits
       b = b & 1 ;                // coger solo el ultimo bit
       return b ;
   }
   
   void Clear()
   {
      for (int j=2; j<10; j++)  // Valores de los pines de columna
        digitalWrite(j, HIGH);     // Todos apagados
      
      for (int k= 10 ; k<18 ; k++)
      {
        int fila = k;
        if (k>13)
        {
             fila = k + 16;         
        }   

        digitalWrite(fila, LOW);    // Todas las filas cortadas   
      }
//      delay(2000);
   }

byte Selecciona( char c, byte fil)
   {
       if ( c == 'P')          return(P[fil]) ;
       if ( c == 'R')          return( R[fil]) ;
       if ( c == 'O')          return( O[fil]);
       if ( c == 'M')          return( M[fil]);
       if ( c == 'E')          return( E[fil]);
       if ( c == 'T')          return( T[fil]);
       if ( c == 'C')          return( C[fil]);
       if ( c == 'N')          return( N[fil]);
       if ( c == '.')          return( dot[fil]);
       if ( c == ' ')          return( sp[fil]);
   }


   void SetChar(char p)
   {
      Clear();
       
      for (int fil = 0; fil <8 ; fil++)
      {
          int fila = fil + 10;
        
          if (fila > 13)
          {
            fila = fila + 16;
          }

          Serial.print("fila: " + fila);
          Serial.println();
              
          digitalWrite( fila, HIGH) ; // Activamos la fila para el barrido
          byte F = Selecciona( p, fil);
          
          for (int col =7; col >= 0 ; col--)
          {
            digitalWrite(8-col, HIGH);   //Bajamos la columna
            bool b = GetBit(F, col)  ;

           // Serial.print("el valor de b : " + b);
           // Serial.println();
           //         delay(2000);
            if (b)   //Levantamos la columna, con su pin
              digitalWrite( 9 - col  ,LOW); 
            else
              digitalWrite( 9 - col  ,HIGH); // Si 0, apagamos
          }
          
          digitalWrite( fila , LOW) ;   // Apagamos fila antes de salir
      }
   }
   



void loop()
   {
       String s = "PROMETEC.NET  " ;
       int l = s.length();          // Calcula la longitus de s
       for ( int n = 0; n< l; n++ )
          {
              long t = millis();
              char c = s[n];

              Serial.print(c);
              Serial.println();
              while ( millis()< t+ 400)
              SetChar(c);
          }
   }




/*
void loop() 
   {
      Clear();
      for (int fil = 0; fil <8 ; fil++)
         {
          
            int fila = fil + 10;
        
            if (fila > 13)
            {
              fila = fila + 16;
            }
          
             digitalWrite( fila , HIGH) ; // Activamos la fila para el barrido
             byte F = P[fil] ;
 
             for (int col =7; col >= 0 ; col--)
               {
                  bool b = GetBit(F, col)  ;
                  if (b)
                      digitalWrite( 9 - col  ,LOW); //Levantamos la columna
                   else
                      digitalWrite( 9 - col  ,HIGH); // Si 0, apagamos
                }                                   
             digitalWrite( fila , LOW) ; // Apagamos fila antes de salir
         }
   }


*/
/*
void loop()
   {
       for (int fil = 0; fil <8 ; fil++)
          {
              byte F = P[fil] ;
              for (int col =7; col >= 0 ; col--)
                 {
                     bool b = GetBit(F, col)  ;
                     Serial.print(b);
                     Serial.print(",");
                 }
              Serial.println();
          }
       Serial.println("----------------------");
                           delay(2000);
   }

 */
