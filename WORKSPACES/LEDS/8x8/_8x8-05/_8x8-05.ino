/*
MATRIX LED    ARDUINO

R1            D2
R2            D3
R3            D4
R4            D5
R5            D6
R6            D7
R7            D8
R8            D9

C1*           D10
C2*           D11
C3*           D12 
C4*           D13
C5*           D30
C6*           D31
C7*           D32
C8*           D33

* ALL MATRIX COLOUMN PINS MUST BE CONNECTED TO THE ARDUINO BOARD VIA A 220R
RESISTOR OTHERWISE YOU MAY RISK DAMAGING THE MODULE.

HCOPTO0011 8X8 MATRIX LED PINOUT:

PIN  1   2   3   4   5   6   7   8
LED  R5  R7  C2  C3  R8  C5  R6  R3


PIN  9   10  11  12  13  14  15  16
LED  R1  C4  C6  R4  C1  R2  C7  C8
*/


byte blank[] =   {0x00, 0x00, 0x00, 0x00, 0x00, 0x00, 0x00, 0x00}; // Char ( )
byte excla[] =   {0x18, 0x3C, 0x3C, 0x18, 0x18, 0x00, 0x18, 0x00}; // Char (!)
byte comillas[] =   {0x66, 0x66, 0x24, 0x00, 0x00, 0x00, 0x00, 0x00}; // Char (")
byte hastag[] =   {0x6C, 0x6C, 0xFE, 0x6C, 0xFE, 0x6C, 0x6C, 0x00}; // Char (#)
byte dolar[] =   {0x18, 0x3E, 0x60, 0x3C, 0x06, 0x7C, 0x18, 0x00}; // Char ($)
/*
byte P[] =   {0x00, 0xC6, 0xCC, 0x18, 0x30, 0x66, 0xC6, 0x00}; // Char (%)
byte P[] =   {0x38, 0x6C, 0x38, 0x76, 0xDC, 0xCC, 0x76, 0x00}; // Char (&)
byte P[] =   {0x18, 0x18, 0x30, 0x00, 0x00, 0x00, 0x00, 0x00}; // Char (')
byte P[] =   {0x0C, 0x18, 0x30, 0x30, 0x30, 0x18, 0x0C, 0x00}; // Char (()
byte P[] =   {0x30, 0x18, 0x0C, 0x0C, 0x0C, 0x18, 0x30, 0x00}; // Char ())
byte P[] =   {0x00, 0x66, 0x3C, 0xFF, 0x3C, 0x66, 0x00, 0x00}; // Char (*)
byte P[] =   {0x00, 0x18, 0x18, 0x7E, 0x18, 0x18, 0x00, 0x00}; // Char (+)
byte P[] =   {0x00, 0x00, 0x00, 0x00, 0x00, 0x18, 0x18, 0x30}; // Char (,)
byte P[] =   {0x00, 0x00, 0x00, 0x7E, 0x00, 0x00, 0x00, 0x00}; // Char (-)
byte P[] =   {0x00, 0x00, 0x00, 0x00, 0x00, 0x18, 0x18, 0x00}; // Char (.)
byte P[] =   {0x06, 0x0C, 0x18, 0x30, 0x60, 0xC0, 0x80, 0x00}; // Char (/)*/
byte _0[] =   {0x38, 0x6C, 0xC6, 0xD6, 0xC6, 0x6C, 0x38, 0x00}; // Char (0)
byte _1[] =   {0x18, 0x38, 0x18, 0x18, 0x18, 0x18, 0x7E, 0x00}; // Char (1)
byte _2[] =   {0x7C, 0xC6, 0x06, 0x1C, 0x30, 0x66, 0xFE, 0x00}; // Char (2)
byte _3[] =   {0x7C, 0xC6, 0x06, 0x3C, 0x06, 0xC6, 0x7C, 0x00}; // Char (3)
byte _4[] =   {0x1C, 0x3C, 0x6C, 0xCC, 0xFE, 0x0C, 0x1E, 0x00}; // Char (4)
byte _5[] =   {0xFE, 0xC0, 0xC0, 0xFC, 0x06, 0xC6, 0x7C, 0x00}; // Char (5)
byte _6[] =   {0x38, 0x60, 0xC0, 0xFC, 0xC6, 0xC6, 0x7C, 0x00}; // Char (6)
byte _7[] =   {0xFE, 0xC6, 0x0C, 0x18, 0x30, 0x30, 0x30, 0x00}; // Char (7)
byte _8[] =   {0x7C, 0xC6, 0xC6, 0x7C, 0xC6, 0xC6, 0x7C, 0x00}; // Char (8)
byte _9[] =   {0x7C, 0xC6, 0xC6, 0x7E, 0x06, 0x0C, 0x78, 0x00}; // Char (9)
/*byte P[] =   {0x00, 0x18, 0x18, 0x00, 0x00, 0x18, 0x18, 0x00}; // Char (:)
byte P[] =   {0x00, 0x18, 0x18, 0x00, 0x00, 0x18, 0x18, 0x30}; // Char (;)
byte P[] =   {0x06, 0x0C, 0x18, 0x30, 0x18, 0x0C, 0x06, 0x00}; // Char (<)
byte P[] =   {0x00, 0x00, 0x7E, 0x00, 0x00, 0x7E, 0x00, 0x00}; // Char (=)
byte P[] =   {0x60, 0x30, 0x18, 0x0C, 0x18, 0x30, 0x60, 0x00}; // Char (>)
byte P[] =   {0x7C, 0xC6, 0x0C, 0x18, 0x18, 0x00, 0x18, 0x00}; // Char (?)
byte P[] =   {0x7C, 0xC6, 0xDE, 0xDE, 0xDE, 0xC0, 0x78, 0x00}; // Char (@)
*/
byte A[] =   {0x38, 0x6C, 0xC6, 0xFE, 0xC6, 0xC6, 0xC6, 0x00}; // Char (A)
byte B[] =   {0xFC, 0x66, 0x66, 0x7C, 0x66, 0x66, 0xFC, 0x00}; // Char (B)
byte C[] =   {0x3C, 0x66, 0xC0, 0xC0, 0xC0, 0x66, 0x3C, 0x00}; // Char (C)
byte D[] =   {0xF8, 0x6C, 0x66, 0x66, 0x66, 0x6C, 0xF8, 0x00}; // Char (D)
byte E[] =   {0xFE, 0x62, 0x68, 0x78, 0x68, 0x62, 0xFE, 0x00}; // Char (E)
byte F[] =   {0xFE, 0x62, 0x68, 0x78, 0x68, 0x60, 0xF0, 0x00}; // Char (F)
byte G[] =   {0x3C, 0x66, 0xC0, 0xC0, 0xCE, 0x66, 0x3A, 0x00}; // Char (G)
byte H[] =   {0xC6, 0xC6, 0xC6, 0xFE, 0xC6, 0xC6, 0xC6, 0x00}; // Char (H)
byte I[] =   {0x3C, 0x18, 0x18, 0x18, 0x18, 0x18, 0x3C, 0x00}; // Char (I)
byte J[] =   {0x1E, 0x0C, 0x0C, 0x0C, 0xCC, 0xCC, 0x78, 0x00}; // Char (J)
byte K[] =   {0xE6, 0x66, 0x6C, 0x78, 0x6C, 0x66, 0xE6, 0x00}; // Char (K)
byte L[] =   {0xF0, 0x60, 0x60, 0x60, 0x62, 0x66, 0xFE, 0x00}; // Char (L)
byte M[] =   {0xC6, 0xEE, 0xFE, 0xFE, 0xD6, 0xC6, 0xC6, 0x00}; // Char (M)
byte N[] =   {0xC6, 0xE6, 0xF6, 0xDE, 0xCE, 0xC6, 0xC6, 0x00}; // Char (N)
byte O[] =   {0x7C, 0xC6, 0xC6, 0xC6, 0xC6, 0xC6, 0x7C, 0x00}; // Char (O)
byte P[] =   {0xFC, 0x66, 0x66, 0x7C, 0x60, 0x60, 0xF0, 0x00}; // Char (P)
byte Q[] =   {0x7C, 0xC6, 0xC6, 0xC6, 0xC6, 0xCE, 0x7C, 0x0E}; // Char (Q)
byte R[] =   {0xFC, 0x66, 0x66, 0x7C, 0x6C, 0x66, 0xE6, 0x00}; // Char (R)
byte S[] =   {0x3C, 0x66, 0x30, 0x18, 0x0C, 0x66, 0x3C, 0x00}; // Char (S)
byte T[] =   {0x7E, 0x7E, 0x5A, 0x18, 0x18, 0x18, 0x3C, 0x00}; // Char (T)
byte U[] =   {0xC6, 0xC6, 0xC6, 0xC6, 0xC6, 0xC6, 0x7C, 0x00}; // Char (U)
byte V[] =   {0xC6, 0xC6, 0xC6, 0xC6, 0xC6, 0x6C, 0x38, 0x00}; // Char (V)
byte W[] =   {0xC6, 0xC6, 0xC6, 0xD6, 0xD6, 0xFE, 0x6C, 0x00}; // Char (W)
byte X[] =   {0xC6, 0xC6, 0x6C, 0x38, 0x6C, 0xC6, 0xC6, 0x00}; // Char (X)
byte Y[] =   {0x66, 0x66, 0x66, 0x3C, 0x18, 0x18, 0x3C, 0x00}; // Char (Y)
byte Z[] =   {0xFE, 0xC6, 0x8C, 0x18, 0x32, 0x66, 0xFE, 0x00}; // Char (Z)
/*byte P[] =   {0x3C, 0x30, 0x30, 0x30, 0x30, 0x30, 0x3C, 0x00}; // Char ([)
byte P[] =   {0xC0, 0x60, 0x30, 0x18, 0x0C, 0x06, 0x02, 0x00}; // Char (\)
byte P[] =   {0x3C, 0x0C, 0x0C, 0x0C, 0x0C, 0x0C, 0x3C, 0x00}; // Char (])
byte P[] =   {0x10, 0x38, 0x6C, 0xC6, 0x00, 0x00, 0x00, 0x00}; // Char (^)
byte P[] =   {0x00, 0x00, 0x00, 0x00, 0x00, 0x00, 0x00, 0xFF}; // Char (_)
byte P[] =   {0x30, 0x18, 0x0C, 0x00, 0x00, 0x00, 0x00, 0x00}; // Char (`)
byte P[] =   {0x00, 0x00, 0x78, 0x0C, 0x7C, 0xCC, 0x76, 0x00}; // Char (a)
byte P[] =   {0xE0, 0x60, 0x7C, 0x66, 0x66, 0x66, 0xDC, 0x00}; // Char (b)
byte P[] =   {0x00, 0x00, 0x7C, 0xC6, 0xC0, 0xC6, 0x7C, 0x00}; // Char (c)
byte P[] =   {0x1C, 0x0C, 0x7C, 0xCC, 0xCC, 0xCC, 0x76, 0x00}; // Char (d)
byte P[] =   {0x00, 0x00, 0x7C, 0xC6, 0xFE, 0xC0, 0x7C, 0x00}; // Char (e)
byte P[] =   {0x3C, 0x66, 0x60, 0xF8, 0x60, 0x60, 0xF0, 0x00}; // Char (f)
byte P[] =   {0x00, 0x00, 0x76, 0xCC, 0xCC, 0x7C, 0x0C, 0xF8}; // Char (g)
byte P[] =   {0xE0, 0x60, 0x6C, 0x76, 0x66, 0x66, 0xE6, 0x00}; // Char (h)
byte P[] =   {0x18, 0x00, 0x38, 0x18, 0x18, 0x18, 0x3C, 0x00}; // Char (i)
byte P[] =   {0x06, 0x00, 0x06, 0x06, 0x06, 0x66, 0x66, 0x3C}; // Char (j)
byte P[] =   {0xE0, 0x60, 0x66, 0x6C, 0x78, 0x6C, 0xE6, 0x00}; // Char (k)
byte P[] =   {0x38, 0x18, 0x18, 0x18, 0x18, 0x18, 0x3C, 0x00}; // Char (l)
byte P[] =   {0x00, 0x00, 0xEC, 0xFE, 0xD6, 0xD6, 0xD6, 0x00}; // Char (m)
byte P[] =   {0x00, 0x00, 0xDC, 0x66, 0x66, 0x66, 0x66, 0x00}; // Char (n)
byte P[] =   {0x00, 0x00, 0x7C, 0xC6, 0xC6, 0xC6, 0x7C, 0x00}; // Char (o)
byte P[] =   {0x00, 0x00, 0xDC, 0x66, 0x66, 0x7C, 0x60, 0xF0}; // Char (p)
byte P[] =   {0x00, 0x00, 0x76, 0xCC, 0xCC, 0x7C, 0x0C, 0x1E}; // Char (q)
byte P[] =   {0x00, 0x00, 0xDC, 0x76, 0x60, 0x60, 0xF0, 0x00}; // Char (r)
byte P[] =   {0x00, 0x00, 0x7E, 0xC0, 0x7C, 0x06, 0xFC, 0x00}; // Char (s)
byte P[] =   {0x30, 0x30, 0xFC, 0x30, 0x30, 0x36, 0x1C, 0x00}; // Char (t)
byte P[] =   {0x00, 0x00, 0xCC, 0xCC, 0xCC, 0xCC, 0x76, 0x00}; // Char (u)
byte P[] =   {0x00, 0x00, 0xC6, 0xC6, 0xC6, 0x6C, 0x38, 0x00}; // Char (v)
byte P[] =   {0x00, 0x00, 0xC6, 0xD6, 0xD6, 0xFE, 0x6C, 0x00}; // Char (w)
byte P[] =   {0x00, 0x00, 0xC6, 0xC6, 0xC6, 0x7E, 0x06, 0xFC}; // Char (y)
byte P[] =   {0x00, 0x00, 0x7E, 0x4C, 0x18, 0x32, 0x7E, 0x00}; // Char (z)
byte P[] =   {0x0E, 0x18, 0x18, 0x70, 0x18, 0x18, 0x0E, 0x00}; // Char ({)
byte P[] =   {0x18, 0x18, 0x18, 0x18, 0x18, 0x18, 0x18, 0x00}; // Char (|)
byte P[] =   {0x70, 0x18, 0x18, 0x0E, 0x18, 0x18, 0x70, 0x00}; // Char (})
byte P[] =   {0x76, 0xDC, 0x00, 0x00, 0x00, 0x00, 0x00, 0x00}; // Char (~)
*/
 void setup()                                        
 {   
    pinMode(2, OUTPUT);
    pinMode(3, OUTPUT);
    pinMode(4, OUTPUT);
    pinMode(5, OUTPUT);
    pinMode(6, OUTPUT);
    pinMode(7, OUTPUT);
    pinMode(8, OUTPUT);
    pinMode(9, OUTPUT);
    pinMode(10, OUTPUT);
    pinMode(11, OUTPUT);
    pinMode(12, OUTPUT);
    pinMode(13, OUTPUT);
    pinMode(30, OUTPUT);
    pinMode(31, OUTPUT);
    pinMode(32, OUTPUT);
    pinMode(33, OUTPUT);     
    Serial.begin(9600);
 }


bool GetBit( byte N, int pos)
   {                 // pos = 7 6 5 4 3 2 1 0
       int b = N >> pos ;         // Shift bits
       b = b & 1 ;                // coger solo el ultimo bit
       return b ;
   }
   
   void Clear()
   {
      for (int j=2; j<10; j++)  // Valores de los pines de columna
        digitalWrite(j, HIGH);     // Todos apagados
      
      for (int k= 10 ; k<18 ; k++)
      {
        int fila = k;
        if (k>13)
        {
             fila = k + 16;         
        }   

        digitalWrite(fila, LOW);    // Todas las filas cortadas   
      }
//      delay(2000);
   }

byte Selecciona( char c, byte fil)
   {
       if ( c == 'A')          return( A[fil]);
       if ( c == 'B')          return( B[fil]);
       if ( c == 'C')          return( C[fil]);
       if ( c == 'D')          return( D[fil]);
       if ( c == 'E')          return( E[fil]);
       if ( c == 'F')          return( F[fil]);
       if ( c == 'G')          return( G[fil]);
       if ( c == 'H')          return( H[fil]);
       if ( c == 'I')          return( I[fil]);
       if ( c == 'J')          return( J[fil]);
       if ( c == 'K')          return( K[fil]);
       if ( c == 'L')          return( L[fil]);
       if ( c == 'M')          return( M[fil]);
       if ( c == 'N')          return( N[fil]);
       if ( c == 'O')          return( O[fil]);
       if ( c == 'P')          return( P[fil]);
       if ( c == 'Q')          return( Q[fil]);
       if ( c == 'R')          return( R[fil]);
       if ( c == 'S')          return( S[fil]);
       if ( c == 'T')          return( T[fil]);
       if ( c == 'U')          return( U[fil]);
       if ( c == 'V')          return( V[fil]);   
       if ( c == 'W')          return( W[fil]);
       if ( c == 'X')          return( X[fil]);
       if ( c == 'Y')          return( Y[fil]);      
       if ( c == 'Z')          return( Z[fil]);            
   }


   void SetChar(char p)
   {
      Clear();
       
      for (int fil = 0; fil <8 ; fil++)
      {
          int fila = fil + 10;
        
          if (fila > 13)
          {
            fila = fila + 16;
          }

          Serial.print("fila: " + fila);
          Serial.println();
              
          digitalWrite( fila, HIGH) ; // Activamos la fila para el barrido
          byte F = Selecciona( p, fil);
          
          for (int col =7; col >= 0 ; col--)
          {
            digitalWrite(8-col, HIGH);   //Bajamos la columna
            bool b = GetBit(F, col)  ;

           // Serial.print("el valor de b : " + b);
           // Serial.println();
           //         delay(2000);
            if (b)   //Levantamos la columna, con su pin
              digitalWrite( 9 - col  ,LOW); 
            else
              digitalWrite( 9 - col  ,HIGH); // Si 0, apagamos
          }
          
          digitalWrite( fila , LOW) ;   // Apagamos fila antes de salir
      }
   }
   



void loop()
   {
       String s = "JAVIER MARTIN ALONSO  " ;
       int l = s.length();          // Calcula la longitus de s
       for ( int n = 0; n< l; n++ )
          {
              long t = millis();
              char c = s[n];

              Serial.print(c);
              Serial.println();
              while ( millis()< t+ 400)
              SetChar(c);
          }
   }




/*
void loop() 
   {
      Clear();
      for (int fil = 0; fil <8 ; fil++)
         {
          
            int fila = fil + 10;
        
            if (fila > 13)
            {
              fila = fila + 16;
            }
          
             digitalWrite( fila , HIGH) ; // Activamos la fila para el barrido
             byte F = P[fil] ;
 
             for (int col =7; col >= 0 ; col--)
               {
                  bool b = GetBit(F, col)  ;
                  if (b)
                      digitalWrite( 9 - col  ,LOW); //Levantamos la columna
                   else
                      digitalWrite( 9 - col  ,HIGH); // Si 0, apagamos
                }                                   
             digitalWrite( fila , LOW) ; // Apagamos fila antes de salir
         }
   }


*/
/*
void loop()
   {
       for (int fil = 0; fil <8 ; fil++)
          {
              byte F = P[fil] ;
              for (int col =7; col >= 0 ; col--)
                 {
                     bool b = GetBit(F, col)  ;
                     Serial.print(b);
                     Serial.print(",");
                 }
              Serial.println();
          }
       Serial.println("----------------------");
                           delay(2000);
   }

 */
